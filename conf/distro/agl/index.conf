## conf/distro/lineage-os/index.conf
```bitbake
#
# LineageOS / Konstakang
#
source_image_url='https://www.androidfilehost.com/?fid=14943124697586370965'
source_image_hash_expected=2458b154b56df2add28ddd27c024d2c1

source_image_archive=lineage-18.1-20210720-UNOFFICIAL-KonstaKANG-rpi4.zip
source_image_hash=
source_image_algo=md5
```
